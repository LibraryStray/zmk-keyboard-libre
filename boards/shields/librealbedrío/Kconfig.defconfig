## boards/shields/librealbedrío/Kconfig.defconfig
```kconfig
if SHIELD_LIBREALBEDRÍO_LEFT

# Name must be less than 16 characters long!
config ZMK_KEYBOARD_NAME
    default "librealbedrío"

config ZMK_SPLIT_ROLE_CENTRAL
    default y

endif

if SHIELD_LIBREALBEDRÍO_LEFT || SHIELD_LIBREALBEDRÍO_RIGHT

config ZMK_SPLIT
    default y

endif
```

## boards/shields/librealbedrío/kconfig.shield
```kconfig
config SHIELD_LIBREALBEDRÍO_LEFT
    def_bool $(shields_list_contains,librealbedrío_left)

config SHIELD_LIBREALBEDRÍO_RIGHT
    def_bool $(shields_list_contains,librealbedrío_right)
```
